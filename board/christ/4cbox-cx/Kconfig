## board/christ/4cbox-cx/Kconfig
```kconfig
if TARGET_4CBOXCX

config SYS_BOARD
	default "4cbox-cx"

config SYS_VENDOR
	default "christ"

config SYS_CONFIG_NAME
	default "4cbox-cx"

endif
```

## board/christ/blix-bx/Kconfig
```kconfig
if TARGET_BLIXBX

config SYS_BOARD
	default "blix-bx"

config SYS_VENDOR
	default "christ"

config SYS_CONFIG_NAME
	default "blix-bx"

endif
```

## board/christ/crix-arx/Kconfig
```kconfig
if TARGET_CRIXARX

config SYS_BOARD
	default "crix-arx"

config SYS_VENDOR
	default "christ"

config SYS_CONFIG_NAME
	default "crix-arx"

endif
```

## board/christ/crix-cx/Kconfig
```kconfig
if TARGET_CRIXCX

config SYS_BOARD
	default "crix-cx"

config SYS_VENDOR
	default "christ"

config SYS_CONFIG_NAME
	default "crix-cx"

endif
```

## board/christ/crix6/Kconfig
```kconfig
if TARGET_CRIX6

config SYS_BOARD
	default "crix6"

config SYS_VENDOR
	default "christ"

config SYS_CONFIG_NAME
	default "crix6"

endif
```

## board/christ/medix-rx/Kconfig
```kconfig
if TARGET_MEDIXRX

config SYS_BOARD
	default "medix-rx"

config SYS_VENDOR
	default "christ"

config SYS_CONFIG_NAME
	default "medix-rx"

endif
```

## board/christ/medix-tx/Kconfig
```kconfig
if TARGET_MEDIXTX

config SYS_BOARD
	default "medix-tx"

config SYS_VENDOR
	default "christ"

config SYS_CONFIG_NAME
	default "medix-tx"

endif
```

## board/christ/pixi-cx/Kconfig
```kconfig
if TARGET_PIXICX

config SYS_BOARD
	default "pixi-cx"

config SYS_VENDOR
	default "christ"

config SYS_CONFIG_NAME
	default "pixi-cx"

endif
```

## board/christ/pixi6/Kconfig
```kconfig
if TARGET_PIXI6

config SYS_BOARD
	default "pixi6"

config SYS_VENDOR
	default "christ"

config SYS_CONFIG_NAME
	default "pixi6"

endif
```

## configs/medix-rq100_defconfig
```kconfig
CONFIG_ARM=y
CONFIG_ARCH_MX6=y
CONFIG_SPL_LIBCOMMON_SUPPORT=y
CONFIG_SPL_LIBGENERIC_SUPPORT=y
CONFIG_TARGET_MEDIXRX=y
CONFIG_VIDEO=y
CONFIG_SYS_EXTRA_OPTIONS="IMX_CONFIG=board/christ/medix-rx/medix-rq100.cfg,MX6Q"
CONFIG_BOOTDELAY=3
# CONFIG_CONSOLE_MUX is not set
CONFIG_SYS_CONSOLE_IS_IN_ENV=y
CONFIG_SYS_CONSOLE_OVERWRITE_ROUTINE=y
CONFIG_HUSH_PARSER=y
CONFIG_CMD_BOOTZ=y
# CONFIG_CMD_IMLS is not set
# CONFIG_CMD_FLASH is not set
CONFIG_CMD_MMC=y
CONFIG_CMD_PART=y
CONFIG_CMD_I2C=y
CONFIG_CMD_USB=y
CONFIG_CMD_USB_MASS_STORAGE=y
CONFIG_CMD_USB_SDP=y
CONFIG_CMD_GPIO=y
CONFIG_CMD_DHCP=y
CONFIG_CMD_MII=y
CONFIG_CMD_PING=y
CONFIG_CMD_CACHE=y
CONFIG_CMD_EXT2=y
CONFIG_CMD_EXT4=y
CONFIG_CMD_EXT4_WRITE=y
CONFIG_CMD_FAT=y
CONFIG_CMD_FS_GENERIC=y
CONFIG_CMD_FBPANEL=y
CONFIG_ENV_IS_IN_MMC=y
CONFIG_NETDEVICES=y
CONFIG_PHYLIB=y
CONFIG_PHY_MICREL=y
CONFIG_PHY_MICREL_KSZ90X1=y
CONFIG_USB=y
CONFIG_USB_STORAGE=y
CONFIG_USB_GADGET=y
CONFIG_USB_GADGET_DOWNLOAD=y
CONFIG_CI_UDC=y
CONFIG_USB_ETHER_ASIX=y
CONFIG_OF_LIBFDT=y
CONFIG_FIT=y
```
